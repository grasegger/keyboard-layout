/*
 * Copyright (c) 2021 The ZMK Contributors
 *
 * SPDX-License-Identifier: MIT
 */

 #include "anna.dtsi"


&kscan0 {
	row-gpios = <&pro_micro 0 GPIO_ACTIVE_HIGH>,
							<&pro_micro 2 GPIO_ACTIVE_HIGH>,
							<&pro_micro 3 GPIO_ACTIVE_HIGH>,
							<&pro_micro 4 GPIO_ACTIVE_HIGH>; 
};