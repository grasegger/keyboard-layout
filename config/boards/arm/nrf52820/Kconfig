## config/boards/arm/nrf52820/Kconfig
```kconfig
# Copyright (c) 2022 Karl Grasegger
# SPDX-License-Identifier: MIT

config BOARD_ENABLE_DCDC
	bool "Enable DCDC mode"
	select SOC_DCDC_NRF52X
	default y
	depends on BOARD_NRF52820
```

## config/boards/arm/nrf52820/Kconfig.board
```kconfig
# Copyright (c) 2022 Karl Grasegger
# SPDX-License-Identifier: MIT

config BOARD_NRF52820
	bool "NRF52820"
	depends on SOC_NRF52820_QDAA
```

## config/boards/arm/nrf52820/Kconfig.defconfig
```kconfig
# Copyright (c) 2022 Karl Grasegger
# SPDX-License-Identifier: MIT

if NRF52820

config ZMK_KEYBOARD_NAME
	default "NRF52820"

if USB_DEVICE_STACK

config USB_NRFX
	default y

endif # USB_DEVICE_STACK

config BT_CTLR
	default BT

config ZMK_BLE
	default y

config ZMK_USB
	default y

endif # NRF52820
```

## config/boards/arm/nrf52820/nrf52820_defconfig
```kconfig
# Copyright (c) 2022 Karl Grasegger
# SPDX-License-Identifier: MIT

CONFIG_SOC_SERIES_NRF52X=y
CONFIG_SOC_NRF52820_QIAA=y
CONFIG_BOARD_NRF52820=y

# Enable MPU
CONFIG_ARM_MPU=y

# enable GPIO
CONFIG_GPIO=y

CONFIG_USE_DT_CODE_PARTITION=y
CONFIG_BUILD_OUTPUT_UF2=y

CONFIG_MPU_ALLOW_FLASH_WRITE=y
CONFIG_NVS=y
CONFIG_SETTINGS_NVS=y
CONFIG_FLASH=y
CONFIG_FLASH_PAGE_LAYOUT=y
CONFIG_FLASH_MAP=y

CONFIG_ZMK_RGB_UNDERGLOW=n
CONFIG_WS2812_STRIP=n
```

## config/boards/arm/nrf52833/Kconfig.board
```kconfig
# Copyright (c) 2022 Karl Grasegger
# SPDX-License-Identifier: MIT

config BOARD_NRF52833
	bool "NRF52833"
	depends on SOC_NRF52833_QIAA
```

## config/boards/arm/nrf52833/Kconfig.defconfig
```kconfig
# Copyright (c) 2022 Karl Grasegger
# SPDX-License-Identifier: MIT

if NRF52833

config ZMK_KEYBOARD_NAME
	default "NRF52833"

if USB_DEVICE_STACK

config USB_NRFX
	default y

endif # USB_DEVICE_STACK

config BT_CTLR
	default BT

config ZMK_BLE
	default y

config ZMK_USB
	default y

endif # NRF52833
```

## config/boards/shields/anna/Kconfig.defconfig
```kconfig
if SHIELD_ANNA_LEFT

config ZMK_KEYBOARD_NAME
    default "Anna"

config ZMK_SPLIT_BLE_ROLE_CENTRAL
    default y
endif

if SHIELD_ANNA_LEFT || SHIELD_ANNA_RIGHT

config ZMK_SPLIT
    default y
endif
```

## config/boards/shields/anna/Kconfig.shield
```kconfig
config SHIELD_ANNA_LEFT
    def_bool $(shields_list_contains,anna_left)

config SHIELD_ANNA_RIGHT
    def_bool $(shields_list_contains,anna_right)
```

## config/boards/shields/anna_7/Kconfig.defconfig
```kconfig
if SHIELD_ANNA_7_LEFT

config ZMK_KEYBOARD_NAME
    default "Anna 7"

config ZMK_SPLIT_BLE_ROLE_CENTRAL
    default y
endif

if SHIELD_ANNA_7_LEFT || SHIELD_ANNA_7_RIGHT

config ZMK_SPLIT
    default y
endif
```

## config/boards/shields/anna_7/Kconfig.shield
```kconfig
config SHIELD_ANNA_7_LEFT
    def_bool $(shields_list_contains,anna_7_left)

config SHIELD_ANNA_7_RIGHT
    def_bool $(shields_list_contains,anna_7_right)
```

## config/boards/shields/anna_butter/Kconfig.defconfig
```kconfig
if SHIELD_ANNA_BUTTER_LEFT

config ZMK_KEYBOARD_NAME
    default "Anna Butter"

config ZMK_SPLIT_BLE_ROLE_CENTRAL
    default y
endif

if SHIELD_ANNA_BUTTER_LEFT || SHIELD_ANNA_BUTTER_RIGHT

config ZMK_SPLIT
    default y
endif
```

## config/boards/shields/anna_butter/Kconfig.shield
```kconfig
config SHIELD_ANNA_BUTTER_LEFT
    def_bool $(shields_list_contains,anna_butter_left)

config SHIELD_ANNA_BUTTER_RIGHT
    def_bool $(shields_list_contains,anna_butter_right)
```

## config/boards/shields/anna_pop/Kconfig.defconfig
```kconfig
if SHIELD_ANNA_POP_LEFT

config ZMK_KEYBOARD_NAME
    default "ANNA POP"

config ZMK_SPLIT_BLE_ROLE_CENTRAL
    default y
endif

if SHIELD_ANNA_POP_LEFT || SHIELD_ANNA_POP_RIGHT

config ZMK_SPLIT
    default y
endif
```

## config/boards/shields/anna_pop/Kconfig.shield
```kconfig
config SHIELD_ANNA_POP_LEFT
    def_bool $(shields_list_contains,anna_pop_left)

config SHIELD_ANNA_POP_RIGHT
    def_bool $(shields_list_contains,anna_pop_right)
```

## config/west.yml
```yaml
manifest:
  remotes:
    - name: zmk
      url-base: https://github.com/zmkfirmware
  projects:
    - name: zmk
      remote: zmk
      revision: main
      import: app/west.yml
  self:
    path: config
```

## nice_nano_v2/anna/lasagna/boards/shields/lasagna/Kconfig.defconfig
```kconfig
if SHIELD_LASAGNA_LEFT

config ZMK_KEYBOARD_NAME
    default "Anna Lasagna"

config ZMK_SPLIT_BLE_ROLE_CENTRAL
    default y
endif

if SHIELD_LASAGNA_LEFT || SHIELD_LASAGNA_RIGHT

config ZMK_SPLIT
    default y
endif
```

## nice_nano_v2/anna/lasagna/boards/shields/lasagna/Kconfig.shield
```kconfig
config SHIELD_LASAGNA_LEFT
    def_bool $(shields_list_contains,lasagna_left)

config SHIELD_LASAGNA_RIGHT
    def_bool $(shields_list_contains,lasagna_right)
```

## nice_nano_v2/anna/lasagna/weirdo/west.yml
```yaml
manifest:
  remotes:
    - name: zmkfirmware
      url-base: https://github.com/zmkfirmware
    - name: grasegger
      url-base: https://github.com/grasegger
  projects:
    - name: zmk
      remote: grasegger
      revision: building
      import: app/west.yml
  self:
    path: config
```

## nice_nano_v2/anna/lasagna/west.yml
```yaml
manifest:
  remotes:
    - name: zmkfirmware
      url-base: https://github.com/zmkfirmware
  projects:
    - name: zmk
      remote: zmkfirmware
      revision: master
      import: app/west.yml
  self:
    path: config
```

## nice_nano_v2/anna/weirdo/boards/shields/weirdo/Kconfig.defconfig
```kconfig
if SHIELD_WEIRDO_LEFT

config ZMK_KEYBOARD_NAME
    default "Anna Weirdo"

config ZMK_SPLIT_BLE_ROLE_CENTRAL
    default y
endif

if SHIELD_WEIRDO_LEFT || SHIELD_WEIRDO_RIGHT

config ZMK_SPLIT
    default y
endif
```
