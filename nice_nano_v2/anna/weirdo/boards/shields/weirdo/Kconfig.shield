## nice_nano_v2/anna/weirdo/boards/shields/weirdo/Kconfig.shield
```kconfig
config SHIELD_WEIRDO_LEFT
    def_bool $(shields_list_contains,weirdo_left)

config SHIELD_WEIRDO_RIGHT
    def_bool $(shields_list_contains,weirdo_right)
```

## nice_nano_v2/anna/weirdo/west.yml
```yaml
manifest:
  remotes:
    - name: zmkfirmware
      url-base: https://github.com/zmkfirmware
    - name: grasegger
      url-base: https://github.com/grasegger
  projects:
    - name: zmk
      remote: zmkfirmware
      revision: main
      import: app/west.yml
  self:
    path: config
```

## nice_nano_v2/kyria/west.yml
```yaml
manifest:
  remotes:
    - name: zmkfirmware
      url-base: https://github.com/zmkfirmware
    - name: grasegger
      url-base: https://github.com/grasegger
    - name: cdc-mkb
      url-base: https://github.com/cdc-mkb
  projects:
    - name: zmk
      remote: cdc-mkb
      revision: mouse-pim447
      import: app/west.yml
  self:
    path: config
```
